## config/west.yml
```yaml
manifest:
  defaults:
    revision: v0.3
  remotes:
    - name: zmkfirmware
      url-base: https://github.com/zmkfirmware
    - name: zzeneg
      url-base: https://github.com/zzeneg
    - name: jameshaston
      url-base: https://github.com/jameshaston
  projects:
    - name: zmk
      remote: zmkfirmware
      import: app/west.yml
    - name: zmk-raw-hid
      remote: zzeneg
      revision: main
    - name: zmk-kb-broadcaster
      remote: jameshaston
      revision: main
  self:
    path: config
```
